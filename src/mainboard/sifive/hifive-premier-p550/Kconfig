## src/mainboard/sifive/hifive-premier-p550/Kconfig
```kconfig
# SPDX-License-Identifier: GPL-2.0-only

if BOARD_SIFIVE_HIFIVE_PREMIER_P550

config BOARD_SPECIFIC_OPTIONS
	def_bool y
	select SOC_ESWIN_EIC7700
	select BOARD_ROMSIZE_KB_4096
	select MISSING_BOARD_RESET
	select FLATTENED_DEVICE_TREE

config MAINBOARD_DIR
	default "sifive/hifive-premier-p550"

config MAINBOARD_PART_NUMBER
	default "HiFive Premier P550"

config FMDFILE
	default "src/mainboard/sifive/hifive-premier-p550/board.fmd"

config HEAP_SIZE
	default 0x20000

endif
```

## src/mainboard/sifive/hifive-premier-p550/Kconfig.name
```kconfig
# SPDX-License-Identifier: GPL-2.0-only

config BOARD_SIFIVE_HIFIVE_PREMIER_P550
	bool "HiFive Premier P550"
```

## src/mainboard/sifive/hifive-unmatched/Kconfig
```kconfig
# SPDX-License-Identifier: GPL-2.0-only

if BOARD_SIFIVE_HIFIVE_UNMATCHED

config BOARD_SPECIFIC_OPTIONS
	def_bool y
	select SOC_SIFIVE_FU740
	select BOARD_ROMSIZE_KB_8192
	select MISSING_BOARD_RESET
	select FLATTENED_DEVICE_TREE
	select SPI_FLASH
	select SPI_FLASH_ISSI
	select SPI_SDCARD

config HIFIVE_UNMATCHED_JTAG_BOOT
	bool "Load CBFS into DRAM over JTAG"
	default n
	help
	  Read the firmware image from DRAM at 0x90000000. Load bootblock
	  at 0x08000000 and start all five harts after reset. Break at
	  cbmem_initialize_empty(), after DDR initialization, to load CBFS
	  before resuming. This leaves SPI flash and the SD card untouched.

config HEAP_SIZE
	default 0x20000

config MAINBOARD_DIR
	default "sifive/hifive-unmatched"

config FMDFILE
	default "src/mainboard/sifive/hifive-unmatched/board.fmd"

config MAINBOARD_PART_NUMBER
	default "HiFive Unmatched"

endif
```

## src/mainboard/spacemit/Kconfig
```kconfig
## SPDX-License-Identifier: GPL-2.0-only
if VENDOR_SPACEMIT
choice
	prompt "Mainboard model"
source "src/mainboard/spacemit/*/Kconfig.name"
endchoice
source "src/mainboard/spacemit/*/Kconfig"
config MAINBOARD_VENDOR
	default "SpacemiT"
endif
```

## src/mainboard/spacemit/Kconfig.name
```kconfig
## SPDX-License-Identifier: GPL-2.0-only
config VENDOR_SPACEMIT
	bool "SpacemiT"
```

## src/mainboard/spacemit/k3-pico-itx/Kconfig
```kconfig
## SPDX-License-Identifier: GPL-2.0-only
if BOARD_SPACEMIT_K3_PICO_ITX
config BOARD_SPECIFIC_OPTIONS
	def_bool y
	select SOC_SPACEMIT_K3
	select FLATTENED_DEVICE_TREE
	select BOARD_ROMSIZE_KB_8192
	select MISSING_BOARD_RESET

config MAINBOARD_DIR
	default "spacemit/k3-pico-itx"
config MAINBOARD_PART_NUMBER
	default "K3 Pico ITX"
config MEMLAYOUT_LD_FILE
	default "src/mainboard/spacemit/k3-pico-itx/memlayout-bootrom.ld"
config FMDFILE
	default "src/mainboard/spacemit/k3-pico-itx/fmap-nor.fmd" if SPACEMIT_K3_NATIVE_BOOT
config K3_CBFS_BASE
	hex "RAM address of the complete staged coreboot ROM"
	default 0x110000000
endif
```

## src/mainboard/spacemit/k3-pico-itx/Kconfig.name
```kconfig
## SPDX-License-Identifier: GPL-2.0-only
config BOARD_SPACEMIT_K3_PICO_ITX
	bool "K3 Pico ITX"
```

## src/soc/eswin/eic7700/Kconfig
```kconfig
# SPDX-License-Identifier: GPL-2.0-only

config SOC_ESWIN_EIC7700
	bool
	select ARCH_RISCV_RV64
	select ARCH_RISCV_S
	select ARCH_RISCV_U
	select ARCH_RISCV_PMP
	select ARCH_BOOTBLOCK_RISCV
	select ARCH_VERSTAGE_RISCV
	select ARCH_ROMSTAGE_RISCV
	select ARCH_RAMSTAGE_RISCV
	select DRIVERS_UART_8250MEM_32
	select UART_OVERRIDE_REFCLK
	select RISCV_USE_ARCH_TIMER
	select RISCV_HAS_OPENSBI

if SOC_ESWIN_EIC7700

config SEPARATE_ROMSTAGE
	default n

config MEMLAYOUT_LD_FILE
	default "src/soc/eswin/eic7700/memlayout.ld"

config RISCV_ARCH
	default "rv64gc_zba_zbb"

config RISCV_ABI
	default "lp64d"

config RISCV_CODEMODEL
	default "medany"

config MAX_CPUS
	default 4

config RISCV_WORKING_HARTID
	default 0

config RISCV_SOC_HAS_MENVCFG
	default n

config OPENSBI_PLATFORM
	default "generic"

config OPENSBI_TEXT_START
	default 0x80000000

config RISCV_OPENSBI
	default y

endif
```

## src/soc/spacemit/k3/Kconfig
```kconfig
# SPDX-License-Identifier: GPL-2.0-only

config SOC_SPACEMIT_K3
	bool
	select ARCH_RISCV_RV64
	select ARCH_RISCV_S
	select ARCH_RISCV_U
	select ARCH_RISCV_PMP
	select ARCH_BOOTBLOCK_RISCV
	select ARCH_VERSTAGE_RISCV
	select ARCH_ROMSTAGE_RISCV
	select ARCH_RAMSTAGE_RISCV
	select DRIVERS_UART_8250MEM_32
	select DRIVERS_UART_8250MEM_UUE
	select UART_OVERRIDE_REFCLK
	select RISCV_HAS_OPENSBI

if SOC_SPACEMIT_K3

config SPACEMIT_K3_BOOTROM
	bool
	select SPACEMIT_K3_EARLY_ESPI

config SPACEMIT_K3_DDR
	bool

config SPACEMIT_K3_NATIVE_BOOT
	def_bool y
	select SPACEMIT_K3_BOOTROM
	select SPACEMIT_K3_DDR
	select SPACEMIT_K3_QSPI
	select CBFS_VERIFICATION
	help
	  Initialize cooling and DDR, stage the normal firmware from NOR or
	  USB Fastboot into DRAM, then use standard coreboot payload loading.

config SPACEMIT_K3_QSPI
	bool "K3 QSPI read-only SPI controller"
	default n
	select SPI_FLASH
	select SPI_FLASH_NO_FAST_READ
	help
	  Use polled IP FIFO reads on CS0 through the standard SPI interface.
	  Board code must configure pads and the clock/reset sequence first.

config SPACEMIT_K3_EARLY_ESPI
	bool "K3 early eSPI Chrome EC transport"
	default n
	select EC_GOOGLE_CHROMEEC
	select EC_GOOGLE_CHROMEEC_MMIO
	help
	  Build the early eSPI and Chrome EC cooling path. Board code must
	  supply clock, reset and pinmux initialization before using it.

config SEPARATE_ROMSTAGE
	default n
config MAX_CPUS
	default 1
config RISCV_ARCH
	default "rv64imafdc"
config RISCV_ABI
	default "lp64d"
config RISCV_CODEMODEL
	default "medany"
config RISCV_WORKING_HARTID
	default 0
config OPENSBI_PLATFORM
	default "generic"
config OPENSBI_TEXT_START
	default 0x100000000
config RISCV_OPENSBI
	default y

endif
```
