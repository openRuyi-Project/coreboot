## src/mainboard/eswin/Kconfig
```kconfig
## SPDX-License-Identifier: GPL-2.0-only

if VENDOR_ESWIN

choice
	prompt "Mainboard model"

source "src/mainboard/eswin/*/Kconfig.name"

endchoice

source "src/mainboard/eswin/*/Kconfig"

config MAINBOARD_VENDOR
	default "ESWIN"

endif # VENDOR_ESWIN
```

## src/mainboard/eswin/d560/Kconfig
```kconfig
# SPDX-License-Identifier: GPL-2.0-only

if BOARD_ESWIN_D560

config BOARD_SPECIFIC_OPTIONS
	def_bool y
	select SOC_ESWIN_EIC7702
	select BOARD_ROMSIZE_KB_4096
	select MISSING_BOARD_RESET
	select FLATTENED_DEVICE_TREE

config MAINBOARD_DIR
	default "eswin/d560"

config MAINBOARD_PART_NUMBER
	default "D560"

config FMDFILE
	default "src/mainboard/eswin/d560/board.fmd"

endif
```

## src/mainboard/milkv/Kconfig
```kconfig
if VENDOR_MILKV

choice
	prompt "Mainboard model"

source "src/mainboard/milkv/*/Kconfig.name"

endchoice

source "src/mainboard/milkv/*/Kconfig"

config MAINBOARD_VENDOR
	default "Milk-V"

endif
```

## src/mainboard/milkv/megrez/Kconfig
```kconfig
# SPDX-License-Identifier: GPL-2.0-only

if BOARD_MILKV_MEGREZ

config BOARD_SPECIFIC_OPTIONS
	def_bool y
	select SOC_ESWIN_EIC7700
	select BOARD_ROMSIZE_KB_4096
	select MISSING_BOARD_RESET
	select FLATTENED_DEVICE_TREE

config MAINBOARD_DIR
	default "milkv/megrez"

config MAINBOARD_PART_NUMBER
	default "Megrez"

config FMDFILE
	default "src/mainboard/milkv/megrez/board.fmd"

config HEAP_SIZE
	default 0x20000

endif
```

## src/mainboard/pine64/starpro64/Kconfig
```kconfig
# SPDX-License-Identifier: GPL-2.0-only

if BOARD_PINE64_STARPRO64

config BOARD_SPECIFIC_OPTIONS
	def_bool y
	select SOC_ESWIN_EIC7700
	select BOARD_ROMSIZE_KB_4096
	select MISSING_BOARD_RESET
	select FLATTENED_DEVICE_TREE

config MAINBOARD_DIR
	default "pine64/starpro64"

config MAINBOARD_PART_NUMBER
	default "StarPro64"

config FMDFILE
	default "src/mainboard/pine64/starpro64/board.fmd"

config HEAP_SIZE
	default 0x20000

endif
```

## src/mainboard/sophgo/Kconfig
```kconfig
# SPDX-License-Identifier: GPL-2.0-only
if VENDOR_SOPHGO

choice
	prompt "Mainboard model"

source "src/mainboard/sophgo/*/Kconfig.name"

endchoice

source "src/mainboard/sophgo/*/Kconfig"

config MAINBOARD_VENDOR
	default "SOPHGO"

endif
```

## src/mainboard/sophgo/sg2042/Kconfig
```kconfig
# SPDX-License-Identifier: GPL-2.0-only

if BOARD_SOPHGO_SG2042

config BOARD_SPECIFIC_OPTIONS
	def_bool y
	select SOC_SOPHGO_SG2042
	select BOARD_ROMSIZE_KB_8192
	select MISSING_BOARD_RESET
	select FLATTENED_DEVICE_TREE

config MAINBOARD_DIR
	default "sophgo/sg2042"

config MAINBOARD_PART_NUMBER
	default "SG2042"

config FMDFILE
	default "src/mainboard/sophgo/sg2042/board.fmd"

config HEAP_SIZE
	default 0x80000

endif
```
